## split-jp60pct-akdk/boards/shields/split_jp60pct/Kconfig.defconfig
```kconfig
if SHIELD_SPLIT_JP60PCT_LEFT

config ZMK_KEYBOARD_NAME
    default "split_jp60pct"

endif

if SHIELD_SPLIT_JP60PCT_LEFT || SHIELD_SPLIT_JP60PCT_RIGHT

config ZMK_SPLIT
    default y

endif
```

## split-jp60pct-akdk/boards/shields/split_jp60pct/Kconfig.shield
```kconfig
config SHIELD_SPLIT_JP60PCT_LEFT
    def_bool $(shields_list_contains,split_jp60pct_left)
config SHIELD_SPLIT_JP60PCT_RIGHT
    def_bool $(shields_list_contains,split_jp60pct_right)
```
